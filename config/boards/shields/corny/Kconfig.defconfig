## config/boards/shields/corny/Kconfig.defconfig
```kconfig
if SHIELD_CORNY_LEFT

config ZMK_KEYBOARD_NAME
    default "Corne"

config ZMK_SPLIT_ROLE_CENTRAL
    default y

endif

if ZMK_SPLIT_ROLE_CENTRAL

menuconfig ZMK_SPLIT_BLE_CENTRAL_BATTERY_LEVEL_FETCHING
		default y

if ZMK_SPLIT_BLE_CENTRAL_BATTERY_LEVEL_FETCHING

config ZMK_SPLIT_BLE_CENTRAL_BATTERY_LEVEL_PROXY
    default y

endif

endif #ZMK_SPLIT_ROLE_CENTRAL

if SHIELD_CORNY_LEFT || SHIELD_CORNY_RIGHT

config ZMK_SPLIT
    default y

config ZMK_DISPLAY
	select LV_FONT_MONTSERRAT_26

if ZMK_DISPLAY

config SPI
	default y

config LS0XX
	default y

config LV_Z_BITS_PER_PIXEL
	default 1

choice LV_COLOR_DEPTH
	default LV_COLOR_DEPTH_1

endchoice

config LV_DPI_DEF
	default 30

config LV_Z_VDB_SIZE
	default 16

endif # ZMK_DISPLAY

endif
```
